## drivers/sensor/icm20948/Kconfig
```kconfig
# ICM20948 Nine-Axis Motion Tracking device configuration options

# Copyright (c) 2021 Nordic Semiconductor ASA
# SPDX-License-Identifier: Apache-2.0

menuconfig ICM20948
	bool "ICM20948 Nine-Axis Motion Tracking Device"
	depends on I2C
	help
	  Enable driver for ICM20948 I2C-based nine-axis motion tracking device.
```

## dts/bindings/sensor/invensense,icm20948.yaml
```yaml
# Copyright (c) 2021 Nordic Semiconductor
# SPDX-License-Identifier: Apache-2.0

description: |
  ICM20948 Motion sensor by invensense

compatible: "invensense,icm20948"

include: [sensor-device.yaml, i2c-device.yaml]
```
